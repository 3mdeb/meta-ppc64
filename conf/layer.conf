## conf/layer.conf
```bitbake
# We have a conf and classes directory, add to BBPATH
BBPATH .= ":${LAYERDIR}"

# We have recipes-* directories, add to BBFILES
BBFILES += "${LAYERDIR}/recipes-*/*/*.bb ${LAYERDIR}/recipes-*/*/*.bbappend"

BBFILE_COLLECTIONS += "ppc64"
BBFILE_PATTERN_ppc64 = "^${LAYERDIR}/"
BBFILE_PRIORITY_ppc64 = "1"

# This should only be incremented on significant changes that will
# cause compatibility issues with other layers
LAYERVERSION_ppc64 = "1"

LAYERDEPENDS_ppc64 = " \
    core \
    "

LAYERSERIES_COMPAT_ppc64 = "gatesgarth master"
```

## conf/machine/include/qemuppc64.inc
```bitbake
#@TYPE: Machine
#@NAME: QEMU PPC 64 machine
#@DESCRIPTION: Machine configuration for running a PPC 64 system on QEMU

require conf/machine/include/qemu.inc
require conf/machine/include/tune-power9.inc

KERNEL_IMAGETYPE = "zImage.epapr"
# KERNEL_IMAGETYPE = "vmlinux"

SERIAL_CONSOLES ?= "115200;ttyS0 115200;hvc0"

################################################################################
# some old  stuff from qemuppc64 from https://github.com/akuster/meta-qemu-bsps/blob/master/conf/machine/qemuppc64.conf
# are thoose still necessary?
# prelink broken on ppc64
# USER_CLASSES_remove = "image-prelink"
# IMAGE_PREPROCESS_COMMAND_remove = "prelink_image;"
# TARGET_CC_KERNEL_ARCH = "-mno-spe"
# KERNEL_IMAGETYPE = "vmlinux"
################################################################################

# For runqemu
QB_SYSTEM_NAME = "qemu-system-ppc64"
QB_MACHINE = "-machine powernv9"
QB_CPU = "-cpu power9"
QB_KERNEL_CMDLINE_APPEND = "console=tty0 console=hvc0"
# taken from: https://github.com/legoater/qemu/wiki/PowerNV#running-qemu
QB_OPT_APPEND = "-smp 2,cores=2,threads=1 -accel tcg,thread=single"
QB_OPT_APPEND += "-device qemu-xhci -device usb-tablet -device usb-kbd"
# QEMU complains with following warning if there is not enough memory:
# warning: skiboot may not work with < 1GB of RAM
QB_MEM = "-m 2048"
# Virtio Networking support
QB_TAP_OPT = "-netdev tap,id=net0,ifname=@TAP@,script=no,downscript=no"
# Virtio block device
QB_ROOTFS_OPT = "-drive file=@ROOTFS@,if=none,format=raw,id=drive0 -device virtio-blk-pci,drive=drive0,id=blk0,bus=pcie.0"
# Virtio serial console
# QB_SERIAL_OPT = "-device virtio-serial-pci -chardev null,id=virtcon -device virtconsole,chardev=virtcon"
# QB_TCPSERIAL_OPT = "-device virtio-serial-pci -chardev socket,id=virtcon,port=@PORT@,host=127.0.0.1 -device virtconsole,chardev=virtcon"
```

## conf/machine/qemuppc64.conf
```bitbake
#@TYPE: Machine
#@NAME: QEMU PPC 64 machine
#@DESCRIPTION: Machine configuration for running a PPC 64 system on QEMU

require conf/machine/include/qemu.inc
require conf/machine/include/tune-power9.inc


SERIAL_CONSOLES ?= "115200;ttyS0 115200;ttyS1"

# POWER9 Big Endian
DEFAULTTUNE = "ppc64p9"

################################################################################
# some old  stuff from qemuppc64 from https://github.com/akuster/meta-qemu-bsps/blob/master/conf/machine/qemuppc64.conf
#prelink broken on ppc64
# USER_CLASSES_remove = "image-prelink"
# IMAGE_PREPROCESS_COMMAND_remove = "prelink_image;"
# TARGET_CC_KERNEL_ARCH = "-mno-spe"
# KERNEL_IMAGETYPE = "vmlinux"
################################################################################

# For runqemu
QB_SYSTEM_NAME = "qemu-system-ppc64"
QB_MACHINE = "-machine powernv"
QB_CPU = "-cpu power9"
QB_KERNEL_CMDLINE_APPEND = "console=tty console=ttyS0"
QB_OPT_APPEND = "-usb -device usb-tablet"
QB_TAP_OPT = "-netdev tap,id=net0,ifname=@TAP@,script=no,downscript=no"
```

## conf/machine/qemuppc64le.conf
```bitbake
#@TYPE: Machine
#@NAME: QEMU PPC 64 machine
#@DESCRIPTION: Machine configuration for running a PPC 64 system on QEMU

require conf/machine/include/qemuppc64.inc

# POWER9 Little Endian
DEFAULTTUNE = "ppc64p9le"
```

## conf/machine/talos-ii-le.conf
```bitbake
#@TYPE: Machine
#@NAME: Talos II machine
#@DESCRIPTION: Machine configuration for running on Talos II (POWER9) hardware

require conf/machine/include/tune-power9.inc

PREFERRED_PROVIDER_virtual/kernel ?= "linux-mainline"

KERNEL_IMAGETYPE = "vmlinux"

SERIAL_CONSOLES ?= "115200;hvc0"

MACHINE_FEATURES = "alsa usbgadget screen keyboard pci usbhost ext2 ext3 serial acpi vfat"

MACHINE_EXTRA_RRECOMMENDS += " kernel-modules"

IMAGE_FSTYPES += "tar.bz2 ext4"

PREFERRED_PROVIDER_virtual/xserver ?= "xserver-xorg"
PREFERRED_PROVIDER_virtual/egl ?= "mesa"
PREFERRED_PROVIDER_virtual/libgl ?= "mesa"
PREFERRED_PROVIDER_virtual/libgles1 ?= "mesa"
PREFERRED_PROVIDER_virtual/libgles2 ?= "mesa"

XSERVER ?= "xserver-xorg \
            ${@bb.utils.contains('DISTRO_FEATURES', 'opengl', 'mesa-driver-swrast xserver-xorg-extension-glx', '', d)} \
            xf86-video-fbdev \
            "

IMAGE_INSTALL_append = " petitboot"
```
